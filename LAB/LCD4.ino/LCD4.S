#define __SFR_OFFSET 0
#include "avr/io.h"



.global start
.global work

/*
 * ##CONNECTIONS
 * 
 * VSS - GND
 * VDD - 5V
 * VEE - GND(CONTRAST)
 * RS - PB1 (9)
 * R/W - PB2(10)
 * E - PB0(8)
 * D0 
 * D1
 * D2
 * D3    -- PD0-PD7
 * D4
 * D5
 * D6
 * D7
 * A - 5V
 * K - GND
 */

start:

//Loading stack pointer
LDI R16,0X04
OUT SPH,R16
LDI R16,0X5F
OUT SPL,R16

LDI R16,0XF0 //Sets all pin as output 
OUT DDRD,R16 
LDI R16,0X07 //sets PB 0,1,2 as output
OUT DDRB,R16


/*
//PIXEL MATRIX 5*7
LDI R16,0X38
RCALL COMMAND

//turn on LCD
LDI R16,0X01
RCALL COMMAND

//cursor ON/cursor Blink
LDI R16,0X0E
RCALL COMMAND 
*/
LDI R16,0X02     
RCALL COMMAND
LDI R16,0X28    
RCALL COMMAND
LDI R16,0X0C       
RCALL COMMAND
LDI R16,0X80
RCALL COMMAND
LDI R16,0X01
RCALL COMMAND
LDI R16,0X0E
RCALL COMMAND
RET


work:

//DATA

LDI R16,'A'
RCALL DATA

L: RJMP L 


COMMAND:

MOV R1,R16
ANDI R16,0XF0
OUT PORTD,R16

LDI R17,0X01
OUT PORTB,R16
LDI R17,0X00
OUT PORTB,R16
CALL DELAY

//LDI R16,0X01
//OUT PORTB,R16

MOV R16,R1
SWAP R16
ANDI R16,0XF0
OUT PORTD,R16

LDI R17,0X01
OUT PORTB,R16
LDI R17,0X00
OUT PORTB,R16
CALL DELAY

RET

DATA:

MOV R1,R16
ANDI R16,0XF0
OUT PORTD,R16

LDI R20,0X03
OUT PORTB,R20
LDI R20,0X02
OUT PORTB,R20
CALL DELAY

MOV R16,R1
SWAP R16
ANDI R16,0XF0;
OUT PORTD,R16

LDI R20,0X03
OUT PORTB,R20
LDI R20,0X02
OUT PORTB,R20
CALL DELAY

RET
 

DELAY:
        LDI R17,0XFF
        L1: LDI R18,0XFF
        L2: DEC R18
        BRNE L2
        DEC R17
        BRNE L1
        RET

/*
//default
COMMAND:
        LDI R16,0X01
        OUT PORTB,R16
        LDI R16,0X00
        OUT PORTB,R16
        CALL DELAY
        RET
DATA:
        LDI R20,0X03
        OUT PORTB,R20
        LDI R20,0X02
        OUT PORTB,R20
        CALL DELAY
        RET
DELAY:
        LDI R17,0XFF
        L1: LDI R18,0XFF
        L2: DEC R18
        BRNE L2
        DEC R17
        BRNE L1
        RET


CBI PORTB,1
SBI PORTB,0
CBI PORTB,0


SBI PORTB,1
SBI PORTB,0
CBI PORTB,0
*/     
