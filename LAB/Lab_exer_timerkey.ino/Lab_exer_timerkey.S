#define __SFR_OFFSET 0
#include "avr/io.h"

.global start
.global work

start:

SBI DDRB,5
SBI DDRB,0
CBI DDRB,1
CBI DDRB,2
SBI PORTB,1
SBI PORTB,2
LDI R16,0X00
STS TCCR1A,R16
LDI R16,0X00
STS TCCR1B,R16
LDI R16,0XF7
LDI R17,0XC2
STS TCNT1L,R16
STS TCNT1H,R17

RET
  
work:

CBI PORTB,0
IN R16,PINB
ANDI R16,0X07
CPI R16,0X04
BRNE L1
LDI R16,0X04
STS TCCR1B,R16
RJMP L2


L1:
CBI PORTB,0
IN R16,PINB
ANDI R16,0X07
CPI R16,0X02
BRNE L2
CBI PORTB,5
LDI R16,0X00
STS TCCR1A,R16
LDI R16,0X00
STS TCCR1B,R16
L2:
    SBIS TIFR1,0
    RET
    SBI TIFR1,0

SBIS PINB,5
SBI PORTB,5
SBIC PINB,5
CBI PORTB,5
RJMP L2


RET
