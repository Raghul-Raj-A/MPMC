#define __SFR_OFFSET 0
#include "avr/io.h"

.global start
.global work

/*
 * ##CONNECTIONS
 * 
 * VSS - GND
 * VDD - 5V
 * VEE - GND(CONTRAST)
 * RS - PB1 (9)
 * R/W - PB2(10)
 * E - PB0(8)
 * D0 
 * D1
 * D2
 * D3    -- PD0-PD7
 * D4
 * D5
 * D6
 * D7
 * A - 5V
 * K - GND
 */

start:

//Loading stack pointer
LDI R16,0X04
OUT SPH,R16
LDI R16,0X5F
OUT SPL,R16

LDI R16,0XFF //Sets all pin as output 
OUT DDRD,R16 
LDI R16,0X07 //sets PB 0,1,2 as output
OUT DDRB,R16

//PIXEL MATRIX 5*7
LDI R16,0X38
OUT PORTD,R16
CALL COMMAND

//clears the screen
LDI R16,0X01
OUT PORTD,R16
CALL COMMAND

LDI R16,0X3C
OUT PORTD,R16
CALL COMMAND

//cursor ON/cursor Blink
LDI R16,0X0E
OUT PORTD,R16
CALL COMMAND 

//KEYPAD
SBI DDRB,5 //Led Output
CBI DDRC,0 //AP 0  input
CBI DDRC,1 //AP 1  input
SBI DDRC,2 //AP 2 output
SBI DDRC,3 //AP 3 output
SBI PORTC,0 //enabling pull-up  
SBI PORTC,1 //""

/*
 * KP  AP
 * 7    A0
 * 6    A1
 * 3    A2
 * 4    A3
 */

work:

// KEYPAD

CBI PORTC,2
SBI PORTC,3
IN R16,PINC
ANDI R16,0x0F

CPI R16,0x0A
BRNE L5

CALL A
CALL BOUNCEDELAY
/*LDI R18,'1'
OUT PORTD,R18
CALL DATA*/
RJMP L8

L5:
CPI R16,0x09
BRNE L6

//CALL B
LDI R18,'4'
OUT PORTD,R18
CALL DATA
CALL BOUNCEDELAY
RJMP L8

L6:
CBI PORTC,3
SBI PORTC,2
IN R16,PINC
ANDI R16,0x0F

CPI R16,0x06
BRNE L7

//CALL C
LDI R18,'2'
OUT PORTD,R18
CALL DATA
CALL BOUNCEDELAY
RJMP L8

L7:
CPI R16,0x05
BRNE L8

//CALL D
LDI R18,'5'
OUT PORTD,R18
CALL DATA
CALL BOUNCEDELAY
L8:
RJMP work
L: RJMP L 

//Functions

A:LDI R18,'1'
  OUT PORTD,R18
  CALL DATA
  RET
  
B:LDI R18,'4'
  OUT PORTD,R18
  CALL DATA

C:LDI R18,'2'
  OUT PORTD,R18
  CALL DATA

D:LDI R18,'5'
  OUT PORTD,R18
  CALL DATA


COMMAND:
        LDI R16,0X01
        OUT PORTB,R16
        LDI R16,0X00
        OUT PORTB,R16
        CALL DELAY
        RET
DATA:
        LDI R20,0X03
        OUT PORTB,R20
        LDI R20,0X02
        OUT PORTB,R20
        CALL DELAY
        RET
DELAY:
        LDI R17,0XFF
        L1: LDI R18,0XFF
        L2: DEC R18
        BRNE L2
        DEC R17
        BRNE L1
        RET

DELAYT:
        LDI R21, 0XFF
        L10:LDI R22,0XFF
        L11:LDI R23,0XFF
        L12:DEC R23
        BRNE L12
        L13:DEC R22
        BRNE L13
        DEC R21
        BRNE L10
        RET

BOUNCEDELAY:
        CALL DELAYT
        CALL DELAYT
        CALL DELAYT
        CALL DELAYT
        CALL DELAYT
        CALL DELAYT
        CALL DELAYT
        CALL DELAYT
        CALL DELAYT
        CALL DELAYT
        RET
