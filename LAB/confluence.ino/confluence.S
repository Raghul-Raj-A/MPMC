#define __SFR_OFFSET 0
#include "avr/io.h"

.global start
.global work

start:

/*/Loading stack pointer
LDI R16,0X04
OUT SPH,R16
LDI R16,0X5F
OUT SPL,R16*/

//LCD
LDI R16,0XFF
OUT DDRD,R16
LDI R16,0X07
OUT DDRB,R16

LDI R16,0X38
OUT PORTD,R16
CALL COMMAND

LDI R16,0X01
OUT PORTD,R16
CALL COMMAND

//LDI R16,0X80
//OUT PORTD,R16
//CALL COMMAND

LDI R16,0X0E
OUT PORTD,R16
CALL COMMAND

//USART
LDI R16,0X00
STS UCSR0A,R16
LDI R16,0X18
STS UCSR0B,R16
LDI R16,0X86
STS UCSR0C,R16

LDI R16,0X00
STS UBRR0H,R16
LDI R16,0X67
STS UBRR0L,R16

//KEYPAD
SBI DDRB,5 //Led Output
CBI DDRC,0 //AP 0  input
CBI DDRC,1 //AP 1  input
SBI DDRC,2 //AP 2 output
SBI DDRC,3 //AP 3 output
SBI PORTC,0 //enabling pull-up  
SBI PORTC,1 //""

//ADC
CBI DDRC,4  //anolog input pin 0 
LDI R16,0X60 //CW : Avcc with ADLAR enabled
STS ADMUX,R16
LDI R16,0XE3 //CW : ADEN 1 ADSOC 1 ADFR 1 PS 8(0 1 1)
STS ADCSRA,R16

RET

work:

// KEYPAD

CBI PORTC,2
SBI PORTC,3
IN R16,PINC
ANDI R16,0x0F
CPI R16,0x0A
BRNE L5
//SBI PORTB,5
CALL USART
RJMP L8

L5:
CPI R16,0x09
BRNE L6
//SBI PORTB,5
CALL ADC
RJMP L8

L6:
CBI PORTC,3
SBI PORTC,2
IN R16,PINC
ANDI R16,0x0F
CPI R16,0x06
BRNE L7
CBI PORTB,5
RJMP L4

L7:
CPI R16,0x05
BRNE L8
CBI PORTB,5

L8:
RJMP work
RET

USART:

L1:LDS R16,UCSR0A
ANDI R16,0X80
BREQ L1
ORI R16,0X80
STS UCSR0A,R16
LDS R22,UDR0
STS UDR0,R22
DEC R22
DEC R22
OUT PORTD,R22
CALL DATA

L2:
LDS R16,UCSR0A
ANDI R16,0X40
BREQ L2
ORI R16,0X40
STS UCSR0A,R16

RJMP USART

LCD:

LDI R16,0X01
OUT PORTD,R16
CALL COMMAND

RET

ADC:

LDS R17,ADCSRA
ANDI R17,0X10 //check/compare whether the interrupt flag is set or not 
//BREQ work     //loops if flag is set ::no need for single conversion
LDS R18,ADCH  
LDS R17,ADCSRA
ORI R17,0X10  //resetting ADIF 
STS ADCSRA,R17

OUT PORTD,R18
CALL DATA

RJMP ADC

COMMAND:
        LDI R16,0X01
        OUT PORTB,R16
        LDI R16,0X00
        OUT PORTB,R16
        CALL DELAY
        //RET
DATA:
        LDI R20,0X03
        OUT PORTB,R20
        LDI R20,0X02
        OUT PORTB,R20
        CALL DELAY
        //RET
DELAY:
        LDI R17,0XFF
        L3: LDI R18,0XFF
        L4: DEC R18
        BRNE L4
        DEC R17
        BRNE L3
        //RET
